#include <EEPROM.h>


/*######################################*/
/*########### Basic Settings ###########*/
/*######################################*/

const int cylinders = 8;                //Number of cylinders used for Tach Signal calibration.
const int vssteeth = 40;                //Number of teeth on VSS ring (40 for 4L60 and 4L80)

const double USRPM = 3200;              //What RPM is our base upshift?
const double DSRPM = 1200;              //What RPM is our base downshift?

const int HUSRPM = 5100;                //What RPM do we UpShift at when in "SportMode"
const int HDSRPM = 3200;                //What RPM do we DownShift at when in "SportMode"

const int HSTSPEED = 20;                 //Speed we shift into 1st (In SportMode)(Only If using SpeedMode or if we Lose Tach Signal)(Downshift ONLY)
const int HNDSPEED = 30;                 //Speed we shift into 2nd (In SportMode)(Only If using SpeedMode or if we Lose Tach Signal)
const int HRDSPEED = 50;                 //Speed we shift into 3rd (In SportMode)(Only If using SpeedMode or if we Lose Tach Signal)
const int HTHSPEED = 60;                 //Speed we shift into 4th (In SportMode)(Only If using SpeedMode or if we Lose Tach Signal)

const int STSPEED = 10;                 //Speed we shift into 1st (Only If using SpeedMode or if we Lose Tach Signal)(Downshift ONLY)
const int NDSPEED = 20;                 //Speed we shift into 2nd (Only If using SpeedMode or if we Lose Tach Signal)
const int RDSPEED = 30;                 //Speed we shift into 3rd (Only If using SpeedMode or if we Lose Tach Signal)
const int THSPEED = 50;                 //Speed we shift into 4th (Only If using SpeedMode or if we Lose Tach Signal)

const double basePressure = 0.22;       //Base shift pressure range 0-0.5 (Inverted) 0 being full hard (Line pressure) 0.5 being full soft (50% line pressure)

const int tcCurve = 100;                //How fast do we engage and disengage the TC Lockup Clutch (Lower is faster)
const double rgear = 4.10;              //What is our Rear end gear?
const int trpm = 747;                   //How many tire revolutions per mile? (You can find a chart online for this.)

const int Mdelay = 500;                 //delay in Milliseconds between Manual mode shifts (Prevents double shifts)


/*
Arduino Pin Assignment \/
*/
//*************************************************************************************************
//NOTICE PRS HAS BEEN SWAPPED WITH THE MODE PIN. OUTPUT PRS ON MODE PIN AND INPUT MODE ON PRS PIN!
//*************************************************************************************************

const int A = 7;
const int B = 6;
const int TCC = 5;
const int PRS = 9;
const int M = 8;
const int DS = 10;
const int US = 11;
const int TACH = 12;
const int VSS = 13;
const int M2 = 2;

const int ST = 3;
const int ND = 4;
const byte RD = A5;
const byte TH = A4;
const byte CLT = A2;
const byte TPS = A1;
const byte PRSA = A0;

/*
Firmware Settings (You shouldnt need to change these) \/
*/
const int prsm = 128;  //MAX Analog output (Maxed out at 50% duty)
const int prasm = 1023; //MAX PRSA reading
const int prm = 128; //MAX of 50% Duty on PRS

/*
Storage Variables \/
*/

int tccv = 0;
int gear = 1;

bool l = false;

int slp = 1500;

int LUSRPM = USRPM;
int LDSRPM = DSRPM;

int LSTSPEED = STSPEED;
int LNDSPEED = NDSPEED;
int LRDSPEED = RDSPEED;
int LTHSPEED = THSPEED;

double tmin = 0;
double tmax = 100;

void setup() {
    pinMode(A, OUTPUT);
    pinMode(B, OUTPUT);
    pinMode(TCC, OUTPUT);
    pinMode(PRS, OUTPUT);
    pinMode(M, INPUT_PULLUP);
    pinMode(DS, INPUT_PULLUP);
    pinMode(US, INPUT_PULLUP);
    pinMode(TACH, INPUT);
    pinMode(VSS, INPUT);
    
    pinMode(ST, OUTPUT);
    pinMode(ND, OUTPUT);
    pinMode(RD, OUTPUT);
    pinMode(TH, OUTPUT);
    pinMode(CLT, INPUT);
    pinMode(TPS, INPUT);
    pinMode(PRSA, INPUT);
    pinMode(M2, INPUT_PULLUP);
    gear = 1;
    setGear(1);
    
    tmax = EEPROM.Read(0);
    tmin = EEPROM.Read(1);
}

void loop() {
  
  if (l) {
    l = false;
    delay(slp);
    return;
  }
  
  if (digitalRead(M2) == LOW) {
    LDSRPM = HDSRPM;
    LUSRPM = HUSRPM;
    
    LUSRPM = HUSRPM;
    LDSRPM = HDSRPM;

    LSTSPEED = HSTSPEED;
    LNDSPEED = HNDSPEED;
    LRDSPEED = HRDSPEED;
    LTHSPEED = HTHSPEED;
    
  }else{
    LUSRPM = USRPM;
    LDSRPM = DSRPM;

    LSTSPEED = STSPEED;
    LNDSPEED = NDSPEED;
    LRDSPEED = RDSPEED;
    LTHSPEED = THSPEED;
  }
  
  if (digitalRead(M) == LOW) {
    int sp = getSpeed();
    int rpm = getRPM();
   if (sp >= rpm) {
    
     if (sp >= NDSPEED) {
      
        if (sp >= RDSPEED) {
        
          if (sp >= THSPEED) {
          
            gear = 4;
            setGear(gear);
      
          
          }else{
           gear = 3;
            setGear(gear);
          }
        
        }else{
          gear = 2;
          setGear(gear);
        }
      
      }else{
        gear = 1;
        //digitalWrite(A7, HIGH);
        setGear(gear);
      }
    
    
    }else if (rpm >= USRPM) {
    
      if (gear <= 3) {
        gear = gear+1;
        setGear(gear);
      }
    
    }else if (rpm <= DSRPM) {
    
      if (gear >= 2) {
        gear = gear-1;
        setGear(gear);
      }
    
    }else{
      if (rpm == 0) {
        if (sp == 0) {
          gear = 1; 
        }
      }
      setGear(gear);
    }
  }else{
    
    
    if (digitalRead(US) == LOW) {
      if (gear <= 3) {
        gear = gear + 1; 
      }
      setGear(gear);
      l = true;
    }else if (digitalRead(DS) == LOW) {
      if (gear >= 2) {
        gear = gear - 1;
      }
      setGear(gear);
      l=true;
    }else{
      setGear(gear);
      l=false;
    }
    
    if (l) {
      delay(Mdelay);
    }
    
  }
}




double getRPM(){
  double rpm = 0;
  
  double ppc = pulseIn(TACH, HIGH);
  double ppms = ppc*1000;
  double pps = ppms*1000;
  double ppm = pps*60;
  double ppr = cylinders/2;
  double ppmr = ppm/ppr;
  
  rpm = ppmr;
  
  
  return rpm;
}

double getSpeed(){
  double s = 0;
  
  //4.10 Rear gear, 747 Rotations Per Mile
  
  double ppl = pulseIn(VSS, HIGH);
  double pms = ppl*1000;
  double spps = pms*1000;
  double sppm = spps*60;
  double pc = sppm/vssteeth;
  double ss = pc/rgear;
  double sps = ss/trpm;
  double sph = sps*60;

  s = sph ;
  
  
  return s;
}

void setPRS(){
  
  int prsc = 0;
  int par = analogRead(PRSA);
  double pam = par/prasm;


  prsc = prsm*pam;
  
  
  double tpsm = getTPS();
  
  if (tpsm > 0) {
    prsc = prsc*tpsm;
  }else{
    prsc = tpsm;
  }
  
  double bp = basePressure;
  
  prsc = ((255*bp)/2)/((255*bp)*tpms)*12.4;
  analogWrite(PRS, prsc);
  
}

double getTps(){
  double tm = 0;
  
  double tp = analogRead(TPS);
  double tpm = 0;
  
  if (tp >= tmax) {
    
    tmax = tp;
    tpm = 1;
    tpm = tpm+1;
    EEPROM.Write(0, tmax/4);
    
  }else if (tp <= tmin) {
    
    tmin = tp;
    tpm = 0;
    tpm = tpm+1;
    EEPROM.Write(1, tmin/4);
    
  }else{
    
    tpm = tp/tmax;
    tpm = tpm+1;
    
  }
  
  tm = tpm;
  return tm;
}

void setTcc(bool on){
  
  int fl = 255;
  int cfl = fl;
  
  if (on) {
    while(cfl >= 0) {
      if (tccv <= 254) {
        tccv = tccv+1; 
      }else{
        tccv = 255;
      }
      
      cfl = cfl-1;
      analogWrite(TCC, tccv);
      delay(tcCurve);
    }
  
    
  }else{
   
    while(cfl >= 0) {
      if (tccv >= 1) {
        tccv = tccv-1;
      }else{
        tccv = 0;
      }
      
      cfl = cfl - 1;
      analogWrite(TCC, tccv);
      delay(tcCurve);
    }
 
  }
  
  cfl = fl;
  
}

void setGear(int g) {
  setPRS();
  l = true;
  if (g == 1) {
  digitalWrite(A, LOW);
  digitalWrite(B, LOW);
  digitalWrite(ST, HIGH);
  digitalWrite(ND, LOW);
  digitalWrite(RD, LOW);
  digitalWrite(TH, LOW);
}else if (g == 2) {
  digitalWrite(A, HIGH);
  digitalWrite(B, LOW);
  digitalWrite(ST, HIGH);
  digitalWrite(ND, HIGH);
  digitalWrite(RD, LOW);
  digitalWrite(TH, LOW);
}else if (g == 3) {
  digitalWrite(A, HIGH);
  digitalWrite(B, HIGH);
  digitalWrite(ST, HIGH);
  digitalWrite(ND, HIGH);
  digitalWrite(RD, HIGH);
  digitalWrite(TH, LOW);
}else if (g == 4) {
  digitalWrite(A, LOW);
  digitalWrite(B, HIGH);
  digitalWrite(ST, HIGH);
  digitalWrite(ND, HIGH);
  digitalWrite(RD, HIGH);
  digitalWrite(TH, HIGH);
}else if (g >= 4) {
  g = 4;
}else if (g < 1) {
  g = 1;
}


//*************************************************************************************************
//NOTICE PRS HAS BEEN SWAPPED WITH THE MODE PIN. OUTPUT PRS ON MODE PIN AND INPUT MODE ON PRS PIN!
//*************************************************************************************************

}
